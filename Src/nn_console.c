/*
 * nn_console.c
 *
 *  Created on: 8 ���. 2017 �.
 *      Author: noname
 */
#include "nn_console.h"

/* Dimensions the buffer into which input characters are placed. */
#define cmdMAX_INPUT_SIZE		50

/* Dimentions a buffer to be used by the UART driver, if the UART driver uses a
buffer at all. */
#define cmdQUEUE_LENGTH			25

/* DEL acts as a backspace. */
#define cmdASCII_DEL		( 0x7F )

/* The maximum time to wait for the mutex that guards the UART to become
available. */
#define cmdMAX_MUTEX_WAIT		pdMS_TO_TICKS( 300 )

#ifndef configCLI_BAUD_RATE
	#define configCLI_BAUD_RATE	9600
#endif

/* Const messages output by the command console. */
static const char * const pcWelcomeMessage = "FreeRTOS command server.\r\nType Help to view a list of registered commands.\r\n\r\n>";
static const char * const pcEndOfOutputMessage = "\r\n[Press ENTER to execute the previous command again]\r\n>";
static const char * const pcNewLine = "\r\n";

/* Used to guard access to the UART in case messages are sent to the UART from
more than one task. */
static SemaphoreHandle_t xTxMutex = NULL;

/* The handle to the UART port, which is not used by all ports. */
static xComPortHandle xPort = 0;

extern UART_HandleTypeDef huart3;
// ---------- ---------- ---------- ---------- ---------- ---------- ---------- ----------
void vStartConsole(uint16_t usStackSize, UBaseType_t uxPriority)
{
	vRegisterCommands();
	xTaskCreate(prvConsoleTask, "CLI", usStackSize, NULL, uxPriority, NULL);
}

// ---------- ---------- ---------- ---------- ---------- ---------- ---------- ----------
//static void prvConsoleTask1( void *pvParameters )
//{
//	uint8_t buff[] = "FROM UART3\n\r";
//	for(;;)
//	{
//		HAL_UART_Transmit_DMA(&huart3, buff, sizeof(buff));
//	}
//}

// ---------- ---------- ---------- ---------- ---------- ---------- ---------- ----------
void prvConsoleTask( void *pvParameters )
{
	signed char cRxedChar;
	uint8_t ucInputIndex = 0;
	char *pcOutputString;
	static char cInputString[ cmdMAX_INPUT_SIZE ], cLastInputString[ cmdMAX_INPUT_SIZE ];
	BaseType_t xReturned;
	//xComPortHandle xPort;

		( void ) pvParameters;

		/* Obtain the address of the output buffer.  Note there is no mutual
		exclusion on this buffer as it is assumed only one command console interface
		will be used at any one time. */
		pcOutputString = FreeRTOS_CLIGetOutputBuffer();

		/* Initialise the UART. */
		//! xPort = xSerialPortInitMinimal( configCLI_BAUD_RATE, cmdQUEUE_LENGTH );
		xPort = &huart3;

		/* Send the welcome message. */
		vSerialPutString( xPort, ( signed char * ) pcWelcomeMessage, ( unsigned short ) strlen( pcWelcomeMessage ) );

		for( ;; )
		{
			/* Wait for the next character.  The while loop is used in case
			INCLUDE_vTaskSuspend is not set to 1 - in which case portMAX_DELAY will
			be a genuine block time rather than an infinite block time. */
			while( xSerialGetChar( xPort, &cRxedChar, portMAX_DELAY ) != pdPASS )
			{
			}

			/* Ensure exclusive access to the UART Tx. */
			//if( xSemaphoreTake( xTxMutex, cmdMAX_MUTEX_WAIT ) == pdPASS )
			//{
				/* Echo the character back. */
			    //I have changed the position of echo
				if( cRxedChar != '\n' || cRxedChar != '\r' )
				{
					xSerialPutChar( xPort, cRxedChar, portMAX_DELAY );
				}

				/* Was it the end of the line? */
				if( cRxedChar == '\n' || cRxedChar == '\r' )
				{
					/* Just to space the output from the input. */
					vSerialPutString( xPort, ( signed char * ) pcNewLine, ( unsigned short ) strlen( pcNewLine ) );
					//vSendNewLine(xPort);

					/* See if the command is empty, indicating that the last command
					is to be executed again. */
					if( ucInputIndex == 0 )
					{
						/* Copy the last command back into the input string. */
						strcpy( cInputString, cLastInputString );
					}

					/* Pass the received command to the command interpreter.  The
					command interpreter is called repeatedly until it returns
					pdFALSE	(indicating there is no more output) as it might
					generate more than one string. */
					do
					{
						/* Get the next output string from the command interpreter. */
						xReturned = FreeRTOS_CLIProcessCommand( cInputString, pcOutputString, configCOMMAND_INT_MAX_OUTPUT_SIZE );

						/* Write the generated string to the UART. */
						vSerialPutString( xPort, ( signed char * ) pcOutputString, ( unsigned short ) strlen( pcOutputString ) );

					} while( xReturned != pdFALSE );

					/* All the strings generated by the input command have been
					sent.  Clear the input string ready to receive the next command.
					Remember the command that was just processed first in case it is
					to be processed again. */
					strcpy( cLastInputString, cInputString );
					ucInputIndex = 0;
					memset( cInputString, 0x00, cmdMAX_INPUT_SIZE );

					vSerialPutString( xPort, ( signed char * ) pcEndOfOutputMessage, ( unsigned short ) strlen( pcEndOfOutputMessage ) );
				}
				else
				{
					if( cRxedChar == '\r' )
					{
						/* Ignore the character. */
					}
					else if( ( cRxedChar == '\b' ) || ( cRxedChar == cmdASCII_DEL ) )
					{
						/* Backspace was pressed.  Erase the last character in the
						string - if any. */
						if( ucInputIndex > 0 )
						{
							ucInputIndex--;
							cInputString[ ucInputIndex ] = '\0';
						}
						//xSerialPutChar( xPort, cRxedChar, portMAX_DELAY );
					}
					else
					{
						/* A character was entered.  Add it to the string entered so
						far.  When a \n is entered the complete	string will be
						passed to the command interpreter. */
						if( ( cRxedChar >= ' ' ) && ( cRxedChar <= '~' ) )
						{
							if( ucInputIndex < cmdMAX_INPUT_SIZE )
							{
								cInputString[ ucInputIndex ] = cRxedChar;
								ucInputIndex++;
							}
						}
						//xSerialPutChar( xPort, cRxedChar, portMAX_DELAY );
					}
				}

				/* Must ensure to give the mutex back. */
				//xSemaphoreGive( xTxMutex );
			//}
		}
}

// ---------- ---------- ---------- ---------- ---------- ---------- ---------- ----------
void vOutputString( const char * const pcMessage )
{
	if( xSemaphoreTake( xTxMutex, cmdMAX_MUTEX_WAIT ) == pdPASS )
	{
		vSerialPutString( xPort, ( signed char * ) pcMessage, ( unsigned short ) strlen( pcMessage ) );
		xSemaphoreGive( xTxMutex );
	}
}
